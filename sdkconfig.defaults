## sdkconfig.defaults
```kconfig
CONFIG_IDF_TARGET_ESP32S3=y
CONFIG_ESP32S3_DEFAULT_CPU_FREQ_160=y
CONFIG_ESP32S3_USE_XTAL_40M=y
CONFIG_ESP_SR_ENABLE=y
CONFIG_ESP_SR_WAKEUP_WORD="hi esp"
CONFIG_ESP_SR_SUPPORT_NOISE_SUPPRESS=y
CONFIG_BT_ENABLED=y
CONFIG_BT_BLE_ENABLED=y
CONFIG_WIFI_ENABLED=y
```
